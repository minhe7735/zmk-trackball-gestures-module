## Kconfig
```kconfig
# Copyright (c) 2024 ZMK Trackball Gestures Contributors
# SPDX-License-Identifier: MIT

config ZMK_TRACKBALL_GESTURES
    bool "ZMK Trackball Gestures Module"
    default y
    help
      Enable the trackball gestures module, which emulates a precision
      touchpad using trackball movement combined with key combos. This
      allows the host OS to receive native multi-finger gesture reports
      (pinch zoom, 2/3/4-finger swipes) from a trackball device.

if ZMK_TRACKBALL_GESTURES

config USB_HID_DEVICE_COUNT
    default 2

config ZMK_TRACKBALL_GESTURES_MAX_FINGERS
    int "Maximum number of virtual fingers"
    default 5
    range 2 5
    help
      The maximum number of virtual finger contact points that can be
      reported simultaneously. Determines the upper limit of supported
      multi-finger gestures. A value of 5 supports all gestures up to
      five-finger swipe. Reducing this value saves memory but limits
      available gesture types.

config ZMK_TRACKBALL_GESTURES_SWIPE_AXIS_LOCK
    bool "Dominant axis snapping for swipe gestures"
    default y
    help
      If enabled, multi-finger swipes will lock to the dominant axis 
      (either strictly vertical or strictly horizontal) after the initial
      movement. This prevents diagonal drift and makes OS gestures like
      switching workspaces much more reliable.

config ZMK_TRACKBALL_GESTURES_REPORT_RATE_MS
    int "Report rate in milliseconds"
    default 8
    help
      Interval in milliseconds between HID touchpad reports sent to the
      host. The default value of 8 ms corresponds to a 125 Hz report rate,
      which provides smooth gesture animation on most systems.
      Lower values (e.g. 4 ms = 250 Hz) increase smoothness but consume
      more USB bandwidth. Higher values (e.g. 16 ms = 62.5 Hz) reduce
      bandwidth usage at the cost of gesture fluidity.

config ZMK_TRACKBALL_GESTURES_IDLE_TIMEOUT_MS
    int "Idle timeout before fingers lift (ms)"
    default 100
    range 50 2000
    help
      The time in milliseconds the trackball must remain idle before the
      virtual fingers are lifted from the trackpad surface. This acts as
      an auto-centering mechanism: when you pause for this long, the fingers
      lift, and the next movement will place them back down in the center
      of the virtual trackpad. Lower values re-center faster, while higher
      values are more forgiving of micro-pauses during slow dragging.

config ZMK_TRACKBALL_GESTURES_TP_LOGICAL_MAX
    int "Logical touchpad size (X/Y maximum)"
    default 32767
    range 100 32767
    help
      The logical maximum coordinate of the emulated touchpad surface.
      This value is reported in the HID descriptor and defines the
      resolution of the virtual touchpad. A value of 32767 effectively
      provides an infinite scrolling surface, eliminating the need for
      edge wrapping.

config ZMK_TRACKBALL_GESTURES_TP_PHYSICAL_MAX
    int "Physical touchpad size (X/Y maximum in 100ths of an inch)"
    default 3200
    range 100 32767
    help
      The physical size of the emulated touchpad, reported in the HID
      descriptor. This dictates how the host OS scales swipe distances.
      If you change the logical maximum, you should proportionally change
      this value to maintain the same scrolling speed and kinetic
      acceleration curves. 3200 equals 32 inches.

config ZMK_TRACKBALL_GESTURES_SENSITIVITY
    int "Trackball delta multiplier"
    default 10
    range 1 500
    help
      Multiplier applied to raw trackball delta values when translating
      them into touchpad finger movements. Higher values make gestures
      more sensitive to small trackball movements; lower values require
      larger physical movements. Adjust this based on your trackball's
      CPI setting and personal preference.

config ZMK_TRACKBALL_GESTURES_PINCH_BASE_DISTANCE
    int "Initial distance between pinch fingers (logical units)"
    default 8000
    range 1 16000
    help
      The initial distance in logical touchpad units between the two
      virtual fingers when a pinch gesture begins. Trackball movement
      increases or decreases this distance to produce zoom-in or zoom-out
      reports. A larger value provides more dynamic range for the pinch
      gesture before fingers overlap or reach the touchpad edges.

config ZMK_TRACKBALL_GESTURES_FINGER_SPACING
    int "Spacing between multi-finger swipe contacts (logical units)"
    default 800
    range 1 8191
    help
      The distance in logical touchpad units between adjacent virtual
      finger contacts during multi-finger swipe gestures. This spacing
      must be large enough for the host OS to recognize distinct contact
      points, but small enough that all fingers fit within the logical
      touchpad surface.

endif # ZMK_TRACKBALL_GESTURES
```

## dts/bindings/behaviors/zmk,behavior-gesture.yaml
```yaml
description: |
  Gesture behavior — activates trackball gesture emulation when held.

  The single parameter selects the gesture mode:
    1 = GESTURE_SWIPE2  (two-finger swipe)
    2 = GESTURE_SWIPE3  (three-finger swipe)
    3 = GESTURE_SWIPE4  (four-finger swipe)
    4 = GESTURE_SWIPE5  (five-finger swipe)
    5 = GESTURE_PINCH2  (two-finger pinch / zoom)
    6 = GESTURE_PINCH3  (three-finger pinch)
    7 = GESTURE_PINCH4  (four-finger pinch)
    8 = GESTURE_PINCH5  (five-finger pinch)

  Example keymap usage:
    bindings = <&gesture 5>;   // pinch-to-zoom while held

compatible: "zmk,behavior-gesture"

include: one_param.yaml
```

## dts/bindings/zmk,input-processor-gesture.yaml
```yaml
description: |
  Input processor that intercepts trackball movement when a gesture mode
  is active.  Place this in your input listener's processor chain so that
  REL_X / REL_Y events are consumed and fed into the gesture engine
  instead of moving the pointer.

  When no gesture is active the processor passes events through unchanged.

  Example device-tree snippet:

    &trackball_listener {
        input-processors = <&gesture_processor>;
    };

compatible: "zmk,input-processor-gesture"

include: ip_zero_param.yaml
```

## dts/bindings/zmk,trackball-gestures.yaml
```yaml
description: |
  Module-level configuration for trackball gesture emulation.
  This node is optional — sensible defaults are used if it is absent.

  Example:
    / {
        trackball_gestures {
            compatible = "zmk,trackball-gestures";
            sensitivity = <15>;
        };
    };

compatible: "zmk,trackball-gestures"

properties:
  sensitivity:
    type: int
    default: 10
    description: |
      Multiplier for converting raw trackball deltas into virtual touchpad
      coordinate changes.  Higher values make gestures more responsive.

  touchpad-width:
    type: int
    default: 4095
    description: |
      Logical X-axis maximum of the virtual touchpad surface.
      Coordinates range from 0 to this value (inclusive).

  touchpad-height:
    type: int
    default: 4095
    description: |
      Logical Y-axis maximum of the virtual touchpad surface.
      Coordinates range from 0 to this value (inclusive).
```
